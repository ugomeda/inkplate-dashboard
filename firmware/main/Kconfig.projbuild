## firmware/main/Kconfig.projbuild
```kconfig
menu "Dashboard configuration"
    config DASHBOARD_WIFI_SSID
        string "Wi-Fi SSID"
        default ""

    config DASHBOARD_WIFI_PASSWORD
        string "Wi-Fi password"
        default ""

    config DASHBOARD_URL
        string "PNG URL"
        default "http://192.168.0.1:8000/live/display_1/png"

    config DASHBOARD_LOW_BATTERY_MV
        int "Low-battery level (millivolts)"
        range 3000 4000
        default 3400

endmenu
```

## firmware/sdkconfig.defaults
```kconfig
CONFIG_PARTITION_TABLE_SINGLE_APP_LARGE=y
CONFIG_SPIRAM=y
CONFIG_SPIRAM_SPEED_40M=y
CONFIG_SPIRAM_BOOT_INIT=y
CONFIG_ESP_MAIN_TASK_STACK_SIZE=16384
```

## firmware/sdkconfig.defaults.inkplate10
```kconfig
CONFIG_INKPLATE_BOARD_INKPLATE10=y

CONFIG_ESPTOOLPY_FLASHSIZE_4MB=y
CONFIG_PARTITION_TABLE_SINGLE_APP_LARGE=y

CONFIG_SPIRAM=y
CONFIG_SPIRAM_SPEED_40M=y
CONFIG_SPIRAM_BOOT_INIT=y

CONFIG_ESP_MAIN_TASK_STACK_SIZE=16384
```

## firmware/sdkconfig.defaults.spectra6
```kconfig
CONFIG_ESPTOOLPY_FLASHSIZE_16MB=y
CONFIG_PARTITION_TABLE_SINGLE_APP_LARGE=y

CONFIG_SPIRAM=y
CONFIG_SPIRAM_MODE_OCT=y
CONFIG_SPIRAM_SPEED_80M=y
CONFIG_SPIRAM_USE_CAPS_ALLOC=y

CONFIG_ESP_MAIN_TASK_STACK_SIZE=16384
```

## spectra6-test/main/Kconfig.projbuild
```kconfig
menu "Dashboard configuration"
    config DASHBOARD_WIFI_SSID
        string "Wi-Fi SSID"
        default ""

    config DASHBOARD_WIFI_PASSWORD
        string "Wi-Fi password"
        default ""

    config DASHBOARD_URL
        string "PNG URL"
        default "http://192.168.0.1:8000/live/display_1/png"

    config DASHBOARD_LOW_BATTERY_MV
        int "Low-battery cutoff (millivolts)"
        range 3000 4000
        default 3400
        help
            Show the warning screen and stop normal updates at or below this voltage.
            Pick a cutoff with enough margin for one full e-paper refresh.

    config DASHBOARD_BATTERY_RECOVERY_MV
        int "Voltage required to leave battery lockout (millivolts)"
        range 3100 4300
        default 3700
        help
            A sufficiently charged battery releases the lockout. The EE02 cannot
            directly report USB VBUS or charger status to the ESP32.
            This value must be larger than DASHBOARD_LOW_BATTERY_MV.

    config DASHBOARD_BATTERY_CHECK_SECONDS
        int "Battery measurement interval during lockout (seconds)"
        range 60 86400
        default 900
        help
            Only the ADC is sampled during lockout. No Wi-Fi or display refresh
            occurs unless the low-battery warning has not yet been displayed.

endmenu
```
